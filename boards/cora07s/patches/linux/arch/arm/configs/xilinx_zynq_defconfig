## boards/microzed/patches/u-boot/configs/zynq_microzed_defconfig
```kconfig
CONFIG_ARM=y
CONFIG_SPL_SYS_DCACHE_OFF=y
CONFIG_ARCH_ZYNQ=y
CONFIG_SYS_TEXT_BASE=0x4000000
CONFIG_SPL_STACK_R_ADDR=0x200000
CONFIG_SPL=y
CONFIG_CMD_ZYNQ_AES=y
CONFIG_DISTRO_DEFAULTS=y
CONFIG_SYS_CUSTOM_LDSCRIPT=y
CONFIG_SYS_LDSCRIPT="arch/arm/mach-zynq/u-boot.lds"
CONFIG_FIT=y
CONFIG_FIT_SIGNATURE=y
CONFIG_FIT_VERBOSE=y
CONFIG_SPL_FIT_PRINT=y
CONFIG_SPL_LOAD_FIT=y
CONFIG_LEGACY_IMAGE_FORMAT=y
CONFIG_USE_PREBOOT=y
CONFIG_SPL_STACK_R=y
CONFIG_SPL_FPGA_SUPPORT=y
CONFIG_SPL_OS_BOOT=y
CONFIG_SPL_SPI_LOAD=y
CONFIG_SYS_SPI_U_BOOT_OFFS=0x100000
# CONFIG_BOOTM_NETBSD is not set
CONFIG_CMD_THOR_DOWNLOAD=y
CONFIG_CMD_MEMTEST=y
CONFIG_SYS_ALT_MEMTEST=y
CONFIG_CMD_DFU=y
CONFIG_CMD_FPGA_LOADBP=y
CONFIG_CMD_FPGA_LOADFS=y
CONFIG_CMD_FPGA_LOADMK=y
CONFIG_CMD_FPGA_LOADP=y
CONFIG_CMD_GPIO=y
CONFIG_CMD_MMC=y
CONFIG_CMD_SF=y
CONFIG_CMD_USB=y
# CONFIG_CMD_SETEXPR is not set
CONFIG_CMD_TFTPPUT=y
CONFIG_CMD_CACHE=y
CONFIG_CMD_EXT4_WRITE=y
CONFIG_DEFAULT_DEVICE_TREE="zynq-microzed"
CONFIG_OF_LIST="zynq-zc702 zynq-zc706 zynq-zc770-xm010 zynq-zc770-xm011 zynq-zc770-xm011-x16 zynq-zc770-xm012 zynq-zc770-xm013 zynq-cc108 zynq-microzed zynq-minized zynq-picozed zynq-zed zynq-zturn zynq-zybo zynq-zybo-z7 zynq-dlc20-rev1.0 zynq-alpha250"
CONFIG_ENV_IS_IN_SPI_FLASH=y
CONFIG_SYS_RELOC_GD_ENV_ADDR=y
CONFIG_ENV_IS_IN_SPI_FLASH=y
CONFIG_NET_RANDOM_ETHADDR=y
CONFIG_SPL_DM_SEQ_ALIAS=y
CONFIG_DFU_MMC=y
CONFIG_DFU_RAM=y
CONFIG_FPGA_XILINX=y
CONFIG_FPGA_ZYNQPL=y
CONFIG_DM_GPIO=y
CONFIG_I2C_MUX=y
CONFIG_I2C_MUX_PCA954x=y
CONFIG_LED=y
CONFIG_LED_GPIO=y
CONFIG_MISC=y
CONFIG_I2C_EEPROM=y
CONFIG_SYS_I2C_EEPROM_ADDR=0x0
CONFIG_SYS_I2C_EEPROM_ADDR_OVERFLOW=0x0
CONFIG_MMC_SDHCI=y
CONFIG_MMC_SDHCI_ZYNQ=y
CONFIG_NAND_ZYNQ=y
CONFIG_SF_DEFAULT_SPEED=30000000
CONFIG_SPI_FLASH_ISSI=y
CONFIG_SPI_FLASH_MACRONIX=y
CONFIG_SPI_FLASH_SPANSION=y
CONFIG_SPI_FLASH_STMICRO=y
CONFIG_SPI_FLASH_WINBOND=y
CONFIG_MII=y
CONFIG_ZYNQ_GEM=y
CONFIG_ZYNQ_SERIAL=y
CONFIG_ZYNQ_QSPI=y
CONFIG_USB=y
CONFIG_USB_EHCI_HCD=y
CONFIG_USB_ULPI_VIEWPORT=y
CONFIG_USB_ULPI=y
CONFIG_USB_GADGET=y
CONFIG_USB_GADGET_MANUFACTURER="Xilinx"
CONFIG_USB_GADGET_VENDOR_NUM=0x03fd
CONFIG_USB_GADGET_PRODUCT_NUM=0x0300
CONFIG_CI_UDC=y
CONFIG_USB_GADGET_DOWNLOAD=y
CONFIG_USB_FUNCTION_THOR=y
CONFIG_DISPLAY=y
CONFIG_SPL_GZIP=y



# CONFIG_SYS_NS16550 is not set
# CONFIG_XILINX_UARTLITE is not set
# CONFIG_XILINX_SPI is not set
# CONFIG_SYS_FLASH_USE_BUFFER_WRITE is not set
# CONFIG_SYS_FLASH_CFI is not set
# CONFIG_FLASH_CFI_DRIVER is not set
# CONFIG_CMD_FLASH is not set
# CONFIG_CMD_IMLS is not set
# CONFIG_MTD_NOR_FLASH is not set
# CONFIG_MTD_DEVICE is not set
# CONFIG_SYS_FLASH_PROTECTION is not set
# CONFIG_MTD_UBI_WL_THRESHOLD is not set
# CONFIG_MTD_UBI_BEB_LIMIT is not set
# CONFIG_SPI_GENERIC is not set
# CONFIG_CMD_UBI is not set
# CONFIG_ZYNQMP_GQSPI is not set
# CONFIG_RBTREE is not set
# CONFIG_CMD_UBIFS is not set
# CONFIG_LZO is not set
# CONFIG_SPI_FLASH_SST is not set
# CONFIG_ZYNQ_SPI is not set
# CONFIG_CMD_NAND is not set
# CONFIG_NAND is not set
# CONFIG_NAND_ARASAN is not set
# CONFIG_CMD_NAND_LOCK_UNLOCK is not set
# CONFIG_XILINX_AXIEMAC is not set
# CONFIG_PHY_TI is not set
# CONFIG_XILINX_EMACLITE is not set
# CONFIG_PHY_VITESSE is not set
# CONFIG_PHY_FIXED is not set
# CONFIG_SATA_CEVA is not set
# CONFIG_DM_SCSI is not set
# CONFIG_AHCI is not set
# CONFIG_SCSI is not set
# CONFIG_CMD_SCSI is not set
# CONFIG_SCSI_AHCI is not set
# CONFIG_CMD_I2C is not set
# CONFIG_DM_I2C is not set
# CONFIG_SYS_I2C_CADENCE is not set
# CONFIG_ZYNQMP_USB is not set
# CONFIG_USB_XHCI_HCD is not set
# CONFIG_USB_XHCI_DWC3 is not set
# CONFIG_USB_XHCI_ZYNQMP is not set
# CONFIG_USB_DWC3 is not set
# CONFIG_USB_DWC3_GADGET is not set
# CONFIG_USB_DWC3_GENERIC is not set
# XILINX_FSL_LINKS is not set
# CONFIG_CMD_UNZIP is not set
# CONFIG_CMD_BOOTI is not set
# CONFIG_BOARD_EARLY_INIT_R is not set

CONFIG_DM=y
CONFIG_SYS_MALLOC_F=y
CONFIG_SYS_GENERIC_BOARD=y
CONFIG_CMD_CACHE=y
CONFIG_SYS_L2CACHE_OFF=y
CONFIG_CMD_CLK=y

CONFIG_ZYNQ_SERIAL=y
CONFIG_DEBUG_UART=y
CONFIG_DEBUG_UART_ZYNQ=y
CONFIG_DEBUG_UART_ANNOUNCE=y

CONFIG_DEBUG_UART_BASE=0xE0001000

CONFIG_DEBUG_UART_CLOCK=50000000

CONFIG_ZYNQ_GEM=y

CONFIG_NET=y
CONFIG_PHY_GIGE=y
CONFIG_NETDEVICES=y
CONFIG_CMD_NET=y
CONFIG_DM_ETH=y
CONFIG_CMD_PING=y
CONFIG_CMD_DHCP=y
CONFIG_PHYLIB=y
CONFIG_CMD_TFTPPUT=y
CONFIG_CMD_NFS=y
CONFIG_CMD_MII=y
CONFIG_PHY_MARVELL=y
CONFIG_PHY_REALTEK=y
CONFIG_PHY_NATSEMI=y

CONFIG_ZYNQ_QSPI=y
CONFIG_SF_DUAL_FLASH=y

CONFIG_CMD_SPI=y
CONFIG_CMD_SF=y
CONFIG_SPI_FLASH=y
CONFIG_SPI_FLASH_BAR=y
CONFIG_DM_SPI_FLASH=y
CONFIG_DM_SPI=y
CONFIG_SPI_FLASH_SPANSION=y
CONFIG_SPI_FLASH_STMICRO=y
CONFIG_SPI_FLASH_WINBOND=y
CONFIG_SPI_FLASH_MACRONIX=y
CONFIG_SPI=y
CONFIG_SPI_FLASH_ISSI=y

CONFIG_MMC=y
CONFIG_DM_MMC=y
CONFIG_MMC_SDHCI_ZYNQ=y
CONFIG_CMD_MMC=y
CONFIG_MMC_SDHCI=y
CONFIG_DOS_PARTITION=y
CONFIG_FAT_WRITE=y

CONFIG_ZYNQ_SDHCI_MAX_FREQ=52000000

CONFIG_USB=y
CONFIG_CMD_USB=y
CONFIG_USB_EHCI_HCD=y
CONFIG_USB_ULPI_VIEWPORT=y
CONFIG_USB_ULPI=y
CONFIG_USB_STORAGE=y
CONFIG_USB_GADGET=y
CONFIG_USB_GADGET_DOWNLOAD=y
CONFIG_CMD_THOR_DOWNLOAD=y
CONFIG_CMD_DFU=y
CONFIG_CMD_EXT2=y
CONFIG_CMD_EXT4=y
CONFIG_CMD_EXT4_WRITE=y
CONFIG_CMD_FAT=y
CONFIG_DFU_RAM=y
CONFIG_USB_FUNCTION_THOR=y


CONFIG_USB_GADGET_VENDOR_NUM=0x03FD

CONFIG_USB_GADGET_PRODUCT_NUM=0x0300

CONFIG_FPGA_XILINX=y
CONFIG_CMD_FPGA_LOADFS=y
CONFIG_FPGA=y
CONFIG_CMD_FPGA=y

CONFIG_SYS_TEXT_BASE=0x00400000

# CONFIG_BOOTARGS is not set

# CONFIG_USE_BOOTARGS is not set

# CONFIG_ENV_IS_IN_FLASH is not set

# CONFIG_ENV_IS_IN_SPI_FLASH is not set

# CONFIG_ENV_IS_NOWHERE is not set

# CONFIG_ENV_IS_IN_NAND is not set


CONFIG_ENV_IS_IN_FAT=y

CONFIG_ENV_FAT_DEVICE_AND_PART="0:auto"

CONFIG_ENV_FAT_FILE="uEnv.txt"

CONFIG_ENV_FAT_INTERFACE="mmc"

CONFIG_DFU_MMC=y

CONFIG_BOOTDELAY=4

CONFIG_SYS_CONFIG_NAME="zynq-microzed"

# CONFIG_SPL is not set

# CONFIG_I2C_EEPROM is not set

# CONFIG_CMD_EEPROM is not set

# CONFIG_SYS_I2C_EEPROM_ADDR_OVERFLOW is not set

# CONFIG_SYS_I2C_EEPROM_ADDR is not set
CONFIG_BOOTCOMMAND="run $modeboot || run distro_bootcmd"
```
